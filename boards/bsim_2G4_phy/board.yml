## boards/bsim_2G4_phy/board.yml
```yaml
boards:
- name: bsim_2G4_phy
  full_name: BabbleSim 2G4 Phy
  vendor: zephyr
  socs:
  - name: native
```

## boards/bsim_device/board.yml
```yaml
boards:
  - name: bsim_device
    full_name: BabbleSim device
    vendor: zephyr
    socs:
      - name: native
        variants:
          - name: empty
          - name: handbrake
          - name: pause_simu
          - name: time_monitor
```

## controller/boards/nrf9160dk_nrf52840.conf
```kconfig
CONFIG_GPIO=y
CONFIG_SYSTEM_WORKQUEUE_STACK_SIZE=512
CONFIG_BT_CTLR_ASSERT_HANDLER=y

CONFIG_UART_1_ASYNC=y
CONFIG_UART_1_INTERRUPT_DRIVEN=n
CONFIG_NRF_SW_LPUART=y
CONFIG_NRF_SW_LPUART_INT_DRIVEN=y
```

## controller/boards/thingy91x_nrf5340_cpunet.conf
```kconfig
CONFIG_UART_ASYNC_API=y
CONFIG_UART_CONSOLE=n
CONFIG_RTT_CONSOLE=y
CONFIG_USE_SEGGER_RTT=y
CONFIG_SHELL_BACKEND_RTT=y

CONFIG_BT_BUF_ACL_TX_SIZE=604
CONFIG_BT_BUF_ACL_RX_SIZE=604
```

## controller/sample.yaml
```yaml
sample:
  name: Bluetooth HCI UART controller for gateway
tests:
  sample.golioth.pouch_gateway.controller:
    harness: bluetooth
    platform_allow:
      - nrf9160dk/nrf52840
    tags:
      - uart
      - bluetooth
```

## gateway/modules/ina260/Kconfig
```kconfig
# Copyright (c) 2023 Golioth, Inc.
# SPDX-License-Identifier: Apache-2.0

config INA260
	bool "INA260 Current and Power Monitor"
	default y
	depends on DT_HAS_TI_INA260_ENABLED
	select I2C
	help
	  Enable driver for the INA260 Current and Power Monitor.
```

## gateway/modules/ina260/dts/bindings/ti,ina260.yaml
```yaml
# Copyright (c) 2023 Golioth, Inc.
# SPDX-License-Identifier: Apache-2.0

description: |
    The INA260 is a digital-output, current, power, and voltage monitor with an i2C interface

compatible: "ti,ina260"

include: [sensor-device.yaml, i2c-device.yaml]
```

## samples/central/Kconfig.sysbuild
```kconfig
# Copyright (c) 2025 Golioth, Inc.
# SPDX-License-Identifier: Apache-2.0

menu "BabbleSim components"

config BSIM_HANDBRAKE
	bool "Handbrake"

endmenu

source "share/sysbuild/Kconfig"
```

## samples/central/sample.yaml
```yaml
sample:
  name: Zephyr Bluetooth central
tests:
  sample.zephyr.central:
    tags: bluetooth
    harness: pytest
    harness_config:
      pytest_dut_scope: module
    sysbuild: true
    platform_allow:
      - nrf52_bsim
    integration_platforms:
      - nrf52_bsim
```

## samples/lightdb/get/Kconfig
```kconfig
# Copyright (c) 2025 Golioth, Inc.
# SPDX-License-Identifier: Apache-2.0

source "${ZEPHYR_GOLIOTH_FIRMWARE_SDK_MODULE_DIR}/examples/zephyr/common/Kconfig.defconfig"

source "Kconfig.zephyr"
```

## samples/lightdb/get/Kconfig.sysbuild
```kconfig
# Copyright (c) 2025 Golioth, Inc.
# SPDX-License-Identifier: Apache-2.0

menu "BabbleSim components"

config BSIM_HANDBRAKE
	bool "Handbrake"
	default y

endmenu

source "share/sysbuild/Kconfig"
```

## samples/lightdb/get/sample.yaml
```yaml
sample:
  description: Use LightDB get
  name: lightdb-get
common:
  harness: pytest
  tags:
    - golioth
    - lightdb
    - socket
    - goliothd
tests:
  sample.pouch_gateway.golioth.lightdb_get:
    sysbuild: true
    platform_allow:
      - nrf52_bsim
```

## west.yml
```yaml
manifest:
  group-filter: [+babblesim]

  projects:
    - name: golioth
      path: modules/lib/golioth-firmware-sdk
      revision: 574656857cb533679dfd069e12867e800873e50a
      url: https://github.com/golioth/golioth-firmware-sdk.git
      submodules: true
      import:
        file: west-zephyr.yml
        name-allowlist:
          - cmsis
          - hal_nordic
          - littlefs
          - mbedtls
          - mcuboot
          - nrf_hw_models
          - picolibc
          - segger
          - tinycrypt
          - zcbor
          - zephyr
        path-allowlist:
          - "tools/bsim"
          - "tools/bsim/*"
          - "tools/bsim/*/*"

    - name: pouch
      path: pouch
      revision: c6e368ba0985d1ad10822c73986eb3f313180da2
      url: git@github.com:golioth/pouch.git

  self:
    path: bluetooth-gateway
    west-commands: scripts/west-commands.yml
```
