## Kconfig.sysbuild
```
# Copyright (c) 2025 Golioth, Inc.
# SPDX-License-Identifier: Apache-2.0

menu "Gateway configuration"

config POUCH_GATEWAY_CLOUD
	bool "Send pouches to cloud"
	default y
	help
	  Disabling cloud communication allows to test Bluetooth gateway
	  functionality without relying on communication with backend. All
	  pouches received from Bluetooth nodes are dropped in that case.

config GOLIOTH_COAP_HOST_URI
	string "CoAP server URI"
	default "coaps://coap.golioth.io"
	help
	  The URI of the CoAP server.

endmenu

menu "BabbleSim components"
	depends on SOC = "native"

config BSIM_HANDBRAKE
	bool "Handbrake"
	default y if POUCH_GATEWAY_CLOUD

endmenu

menu "BabbleSim peripherals"
	depends on SOC = "native"

config PERIPHERAL_ZEPHYR
	bool "Zephyr"
	help
	  Zephyr peripheral sample.

config PERIPHERAL_ZEPHYR_NUM
	int "Number of Zephyr peripherals"
	default 1
	depends on PERIPHERAL_ZEPHYR

config PERIPHERAL_PERIODIC_UPLINK
	bool "Periodic uplink"
	help
	  Periodic uplink sample.

config PERIPHERAL_PERIODIC_UPLINK_NUM
	int "Number of periodic uplink peripherals"
	default 1
	depends on PERIPHERAL_PERIODIC_UPLINK

config PERIPHERAL_BLE_GATT_EXAMPLE
	bool "BLE GATT example"
	default y
	help
	  BLE GATT sample.

config PERIPHERAL_BLE_GATT_EXAMPLE_NUM
	int "Number of BLE GATT example peripherals"
	default 1
	depends on PERIPHERAL_BLE_GATT_EXAMPLE

endmenu

config PERIPHERAL_MOUNT_CREDS
	bool "Mount credentials under /creds directory"
	help
	  Mount credentials located ${BUILD_DIR}/creds under /creds mountpoint in Zephyr.

choice BOOTLOADER
	default BOOTLOADER_MCUBOOT if SOC != "native"
endchoice

source "share/sysbuild/Kconfig"
```

## sample.yaml
```
sample:
  name: Pouch Gateway with custom connect
tests:
  pouch-gateway.sample.custom_connect:
    tags: bluetooth
    harness: pytest
    harness_config:
      pytest_dut_scope: module
    sysbuild: true
    platform_allow:
      - nrf52_bsim
    integration_platforms:
      - nrf52_bsim
    extra_args:
      - SB_CONFIG_PERIPHERAL_MOUNT_CREDS=y
      - peripheral_ble_gatt_example_0_CONFIG_PICOLIBC=y
      - peripheral_ble_gatt_example_0_CONFIG_FILE_SYSTEM_NSIM_MOUNT=y
      - peripheral_ble_gatt_example_0_CONFIG_EXAMPLE_SYNC_PERIOD_S=2
    timeout: 120
```

## prj.conf
```kconfig
CONFIG_POUCH_GATEWAY=y

CONFIG_BT=y
CONFIG_BT_CENTRAL=y
CONFIG_BT_MAX_CONN=16
CONFIG_BT_GATT_CLIENT=y
CONFIG_BT_GATT_CACHING=n
CONFIG_BT_GATT_AUTO_UPDATE_MTU=y
CONFIG_BT_L2CAP_TX_MTU=247
CONFIG_BT_BUF_ACL_TX_SIZE=251
CONFIG_BT_BUF_ACL_RX_SIZE=251

CONFIG_COAP_INIT_ACK_TIMEOUT_MS=3000

CONFIG_LOG=y

# Settings subsystem
CONFIG_FCB=y
CONFIG_FLASH=y
CONFIG_FLASH_MAP=y

CONFIG_SETTINGS=y
CONFIG_SETTINGS_FCB=y

# Application
CONFIG_GOLIOTH_SAMPLE_COMMON=y
CONFIG_GOLIOTH_SAMPLE_SETTINGS_SHELL=y

# Golioth Firmware SDK with all dependencies
CONFIG_GOLIOTH_FIRMWARE_SDK=y
CONFIG_GOLIOTH_GATEWAY=y

# Golioth logging backend
CONFIG_LOG_MODE_DEFERRED=y
CONFIG_LOG_BACKEND_GOLIOTH=y

# Application
CONFIG_MAIN_STACK_SIZE=2048
CONFIG_SYSTEM_WORKQUEUE_STACK_SIZE=2048

# Pouch BLE GATT Transport
CONFIG_POUCH_TRANSPORT_GATT_COMMON=y

CONFIG_ZVFS_EVENTFD_MAX=11

# Pouch server certificate parse
CONFIG_MBEDTLS_PSA_CRYPTO_C=y
CONFIG_MBEDTLS_PEM_CERTIFICATE_FORMAT=y
CONFIG_PSA_WANT_ALG_ECDSA=y
CONFIG_PSA_WANT_ALG_SHA_384=y
CONFIG_PSA_WANT_ECC_SECP_R1_256=y
CONFIG_PSA_WANT_ECC_SECP_R1_384=y
CONFIG_PSA_WANT_KEY_TYPE_ECC_PUBLIC_KEY=y
```

## src/main.c
```c
/*
 * Copyright (c) 2025 Golioth, Inc.
 *
 * SPDX-License-Identifier: Apache-2.0
 */

#include <zephyr/bluetooth/bluetooth.h>
#include <zephyr/bluetooth/conn.h>
#include <zephyr/bluetooth/hci.h>
#include <zephyr/net/net_if.h>
#include <zephyr/net/dhcpv4.h>

#include <golioth/client.h>
#include <golioth/gateway.h>
#include <samples/common/sample_credentials.h>

#include <pouch/transport/gatt/common/types.h>

#include <pouch_gateway/bt/connect.h>
#include <pouch_gateway/cert.h>
#include <pouch_gateway/downlink.h>
#include <pouch_gateway/uplink.h>

#include "scan.h"

#include <zephyr/logging/log.h>
LOG_MODULE_REGISTER(main);

struct sync_data
{
    struct k_work_delayable work;
    struct bt_conn *conn;
    int counter;
};

static struct sync_data sync_data;

struct golioth_client *client;

#ifdef CONFIG_POUCH_GATEWAY_CLOUD

static K_SEM_DEFINE(connected, 0, 1);

static void on_client_event(struct golioth_client *client,
                            enum golioth_client_event event,
                            void *arg)
{
    bool is_connected = (event == GOLIOTH_CLIENT_EVENT_CONNECTED);
    if (is_connected)
    {
        k_sem_give(&connected);
    }
    LOG_INF("Golioth client %s", is_connected ? "connected" : "disconnected");
}

static void connect_golioth_client(void)
{
    const struct golioth_client_config *client_config = golioth_sample_credentials_get();
    if (client_config == NULL || client_config->credentials.psk.psk_id_len == 0
        || client_config->credentials.psk.psk_len == 0)
    {
        LOG_ERR("No credentials found.");
        LOG_ERR(
            "Please store your credentials with the following commands, then reboot the device.");
        LOG_ERR("\tsettings set golioth/psk-id <your-psk-id>");
        LOG_ERR("\tsettings set golioth/psk <your-psk>");
        return;
    }

    client = golioth_client_create(client_config);

    golioth_client_register_event_callback(client, on_client_event, NULL);
}

#ifdef CONFIG_NRF_MODEM
#include <modem/lte_lc.h>
static void lte_handler(const struct lte_lc_evt *const evt)
{
    if (evt->type == LTE_LC_EVT_NW_REG_STATUS)
    {

        if ((evt->nw_reg_status == LTE_LC_NW_REG_REGISTERED_HOME)
            || (evt->nw_reg_status == LTE_LC_NW_REG_REGISTERED_ROAMING))
        {

            if (!client)
            {
                connect_golioth_client();
            }
        }
    }
}
#endif /* CONFIG_NRF_MODEM */

static void connect_to_cloud(void)
{
#if defined(CONFIG_NRF_MODEM)
    LOG_INF("Connecting to LTE, this may take some time...");
    lte_lc_connect_async(lte_handler);
#else
#if defined(CONFIG_NET_L2_ETHERNET) && defined(CONFIG_NET_DHCPV4)
    net_dhcpv4_start(net_if_get_default());
#endif
    connect_golioth_client();
#endif

    LOG_INF("Waiting for network connection");
    k_sem_take(&connected, K_FOREVER);
}

#else /* CONFIG_POUCH_GATEWAY_CLOUD */

static inline void connect_to_cloud(void) {}

#endif /* CONFIG_POUCH_GATEWAY_CLOUD */

static void bt_connected(struct bt_conn *conn, uint8_t err)
{
    char addr[BT_ADDR_LE_STR_LEN];

    bt_addr_le_to_str(bt_conn_get_dst(conn), addr, sizeof(addr));

    if (err)
    {
        LOG_ERR("Failed to connect to %s %u %s", addr, err, bt_hci_err_to_str(err));

        bt_conn_unref(conn);

        custom_scan_start();
        return;
    }

    LOG_INF("Connected: %s", addr);

    sync_data.conn = conn;
    sync_data.counter = 0;

    k_work_schedule(&sync_data.work, K_NO_WAIT);
}

static void bt_disconnected(struct bt_conn *conn, uint8_t reason)
{
    char addr[BT_ADDR_LE_STR_LEN];

    bt_addr_le_to_str(bt_conn_get_dst(conn), addr, sizeof(addr));
    LOG_INF("Disconnected: %s, reason 0x%02x %s", addr, reason, bt_hci_err_to_str(reason));

    pouch_gateway_bt_stop(conn);

    bt_conn_unref(conn);

    custom_scan_start();
}

BT_CONN_CB_DEFINE(conn_callbacks) = {
    .connected = bt_connected,
    .disconnected = bt_disconnected,
};

static void sync_start_handler(struct k_work *work)
{
    pouch_gateway_bt_start(sync_data.conn);
}

void pouch_gateway_bt_finished(struct bt_conn *conn)
{
    sync_data.counter++;

    if (sync_data.counter > 1)
    {
        LOG_INF("Disconnecting");
        bt_conn_disconnect(conn, BT_HCI_ERR_REMOTE_USER_TERM_CONN);
    }
    else
    {
        LOG_INF("Start sync once again in 5s");
        k_work_schedule(&sync_data.work, K_SECONDS(5));
    }
}

int main(void)
{
    LOG_INF("Gateway Version: " STRINGIFY(GIT_DESCRIBE));
    LOG_INF("Pouch BLE Transport Protocol Version: %d", POUCH_GATT_VERSION);

    k_work_init_delayable(&sync_data.work, sync_start_handler);

    connect_to_cloud();

    pouch_gateway_cert_module_on_connected(client);
    pouch_gateway_uplink_module_init(client);
    pouch_gateway_downlink_module_init(client);

    int err = bt_enable(NULL);
    if (err)
    {
        LOG_ERR("Bluetooth init failed (err %d)", err);
        return err;
    }

    LOG_INF("Bluetooth initialized");

    custom_scan_start();

#ifdef CONFIG_POUCH_GATEWAY_CLOUD
    while (true)
    {
        k_sem_take(&connected, K_FOREVER);
        pouch_gateway_cert_module_on_connected(client);
    }
#endif

    return 0;
}
```

## src/scan.c
```c
/*
 * Copyright (c) 2025 Golioth, Inc.
 *
 * SPDX-License-Identifier: Apache-2.0
 */

#include <zephyr/bluetooth/bluetooth.h>
#include <zephyr/bluetooth/conn.h>
#include <zephyr/bluetooth/uuid.h>

#include <pouch/transport/gatt/common/types.h>
#include <pouch/transport/gatt/common/uuids.h>

#include "scan.h"

#include <zephyr/logging/log.h>
LOG_MODULE_REGISTER(custom_scan, LOG_LEVEL_DBG);

static inline bool version_is_compatible(const struct pouch_gatt_adv_data *adv_data)
{
    uint8_t self_ver =
        adv_data->version & POUCH_GATT_ADV_VERSION_SELF_MASK >> POUCH_GATT_ADV_VERSION_SELF_SHIFT;

    return POUCH_GATT_VERSION == self_ver;
}

static inline bool sync_requested(const struct pouch_gatt_adv_data *adv_data)
{
    return (adv_data->flags & POUCH_GATT_ADV_FLAG_SYNC_REQUEST);
}

struct tf_data
{
    bool is_tf;
    bool name_is_golioth;
    struct pouch_gatt_adv_data adv_data;
};

static const struct bt_uuid_16 golioth_svc_uuid_16 = BT_UUID_INIT_16(POUCH_GATT_UUID_SVC_VAL_16);

static bool data_cb(struct bt_data *data, void *user_data)
{
    struct tf_data *tf = user_data;

    switch (data->type)
    {
        case BT_DATA_NAME_COMPLETE:
        {
            if (!strncmp(data->data, "Golioth", data->data_len))
            {
                tf->name_is_golioth = true;
            }

            return true;
        }

        case BT_DATA_SVC_DATA16:
        {
            const struct pouch_gatt_adv_data *adv_data;

            if (data->data_len >= sizeof(golioth_svc_uuid_16.val) + sizeof(*adv_data)
                && memcmp(&golioth_svc_uuid_16.val, data->data, sizeof(golioth_svc_uuid_16.val))
                    == 0)
            {
                adv_data = (const void *) &data->data[sizeof(golioth_svc_uuid_16.val)];

                tf->is_tf = true;
                tf->adv_data = *adv_data;

                return true;
            }
            return true;
        }

        default:
            return true;
    }
}

static void device_found(const bt_addr_le_t *addr,
                         int8_t rssi,
                         uint8_t type,
                         struct net_buf_simple *ad)
{
    char addr_str[BT_ADDR_LE_STR_LEN];
    struct tf_data tf = {
        .is_tf = false,
    };
    int err;

    /* We're only interested in connectable events */
    if (type != BT_GAP_ADV_TYPE_ADV_IND && type != BT_GAP_ADV_TYPE_ADV_DIRECT_IND
        && type != BT_GAP_ADV_TYPE_SCAN_RSP)
    {
        return;
    }

    bt_addr_le_to_str(addr, addr_str, sizeof(addr_str));
    LOG_DBG("Device found: %s (RSSI %d)", addr_str, rssi);

    bt_data_parse(ad, data_cb, &tf);
    LOG_DBG("is_tf=%d version=0x%0x flags=0%0x name_is_golioth=%d rssi=%d",
            (int) tf.is_tf,
            tf.adv_data.version,
            tf.adv_data.flags,
            tf.name_is_golioth,
            rssi);

    if (tf.is_tf && tf.name_is_golioth && rssi > -70 && version_is_compatible(&tf.adv_data)
        && sync_requested(&tf.adv_data))
    {
        err = bt_le_scan_stop();
        if (err)
        {
            LOG_ERR("Failed to stop scanning");
            return;
        }

        struct bt_conn *conn = NULL;
        err = bt_conn_le_create(addr, BT_CONN_LE_CREATE_CONN, BT_LE_CONN_PARAM_DEFAULT, &conn);
        if (err)
        {
            LOG_ERR("Create auto conn failed (%d)", err);
            custom_scan_start();
            return;
        }
    }
}

void custom_scan_start(void)
{
    int err;

    err = bt_le_scan_start(BT_LE_SCAN_PARAM(BT_LE_SCAN_TYPE_ACTIVE,
                                            BT_LE_SCAN_OPT_NONE,
                                            BT_GAP_SCAN_FAST_INTERVAL_MIN,
                                            BT_GAP_SCAN_FAST_WINDOW),
                           device_found);
    if (err)
    {
        LOG_ERR("Scanning failed to start (err %d)", err);
        return;
    }

    LOG_INF("Scanning successfully started");
}
```
